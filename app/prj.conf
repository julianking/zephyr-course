## CMakeLists.txt
```
cmake_minimum_required(VERSION 3.20.0)

list(APPEND BOARD_ROOT ${CMAKE_CURRENT_SOURCE_DIR}/../)

find_package(Zephyr REQUIRED)
project(my_zephyr_app)

target_sources(app PRIVATE src/main.cpp)

add_subdirectory(drivers/led_sensor)
```

## Kconfig
```
config APP_HEARTBEAT_PERIOD_MS
    int "LED Heartbeat period (ms)"
    range 100 2000
    default 500

source "Kconfig.zephyr"
rsource "drivers/led_sensor/Kconfig"
```

## prj.conf
```kconfig
CONFIG_GPIO=y
CONFIG_LOG=y
CONFIG_MY_LED_SENSOR=y

CONFIG_SHELL=y
CONFIG_SHELL_BACKEND_SERIAL=y
```

## app.overlay
```dts
/ {
    led_sensor0: led_sensor {
        compatible = "my,led_sensor";
        status = "okay";
    };

    aliases {
        app-led = &green_led_1;
    };
};
```

## src/main.cpp
```c
#include <zephyr/drivers/gpio.h>
#include <zephyr/kernel.h>
#include <zephyr/logging/log.h>
#include "../drivers/led_sensor/led_sensor.h"

/* The devicetree node identifier for the "led0" alias. */
#define LED_NODE DT_ALIAS(app_led)

static const struct gpio_dt_spec led = GPIO_DT_SPEC_GET(LED_NODE, gpios);

LOG_MODULE_REGISTER(main, LOG_LEVEL_INF);

int main(void)
{
    const struct device *driver = DEVICE_DT_GET(DT_NODELABEL(led_sensor0));
    struct sensor_value val = {0};

    if (!device_is_ready(driver))
        return -1;


    while (1) {

       k_msleep(1000);
    }
    return 0;
}
```
